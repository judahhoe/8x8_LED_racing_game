#include "LedControl.h"

int DIN = 11;
int CS = 10;
int CLK = 13;
LedControl lc = LedControl(DIN, CLK, CS, 0);

int playerRow = 6;
int playerCol = 3;
int roadRow = 0;
int currRoadRow = 0;

//Predefined map. Every column is the same so the game is not too fast on 200ms delay
uint8_t road_map[360] = {B10000001, B10000001, B10000001,
                         B10000001, B10000001, B10000001,
                         B10000001, B10000001, B10000001,
                         B10000001, B10000001, B10000001,
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                         B11100011,B11100011,B11100011};

uint8_t skull[8] = {B01111110,
                    B11111111,
                    B10011001,
                    B10011001,
                    B11111111,
                    B01111110,
                    B01011010,
                    B01011010};

void setup()
{
  pinMode(2, INPUT_PULLUP);  // Left button
  pinMode(3, INPUT_PULLUP);  // Right button

  lc.shutdown(0, false);
  lc.setIntensity(0, 0);
  lc.clearDisplay(0);
}


void movePlayerLeft()
{
  if (playerCol > 1)
  {
    playerCol = playerCol - 1;
  }
  else
  {
    restartGame();
  }
}

void movePlayerRight()
{
  if (playerCol < 6)
  {
    playerCol = playerCol + 1;
  }
  else
  {
    restartGame();
  }
}

void restartGame()
{
  lc.clearDisplay(0);
  playerCol = 4;
  roadRow = 0;
  currRoadRow = 0;
  for (int i = 7; i >= 0; i--)
  {
    lc.setRow(0, i, skull[i]);
  }
  delay(2000); // II opóźnienie przed restartem gry
  lc.clearDisplay(0);
}

void loop()
{
  lc.clearDisplay(0);
  
  int pinValueLeft = digitalRead(2);
  int pinValueRight = digitalRead(3);

  if (pinValueLeft == 0)
  {
    movePlayerLeft();
  }

  if (pinValueRight == 0)
  {
    movePlayerRight();
  }


  for (int i = 7; i >= 0; i--)
  {
    lc.setRow(0, i, road_map[currRoadRow]);
    currRoadRow++;
    if (currRoadRow == 359)
    {
      currRoadRow = 0;
    }
  }

  roadRow++;
  if (roadRow == 359)
  {
    roadRow = 0;
  }
  currRoadRow = roadRow;


  // Check if the player LED moved into a lit-up LED
  if ((road_map[roadRow] & (1 << 7-playerCol)) != 0)
  {
    restartGame();
  }


  lc.setLed(0, playerRow, playerCol, true);
  delay(200);
}